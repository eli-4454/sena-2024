#include <XboxSeriesXControllerESP32_asukiaaa.hpp>
#include <Adafruit_GFX.h>
#include <Adafruit_SSD1306.h>

#define IN1_A 12
#define IN2_A 13
#define IN1_B 27
#define IN2_B 4

#define SCREEN_WIDTH 128 // OLED display width, in pixels
#define SCREEN_HEIGHT 64 // OLED display height, in pixels
#define OLED_RESET    -1 // Reset pin # (or -1 if sharing Arduino reset pin)
#define OLED_I2C_ADDRESS 0x3C // Dirección I2C de la pantalla OLED

#define SPEED_SCALE 235 // Factor de escala para ajustar la sensibilidad del control de velocidad
#define DEADZONE 0.1    // Zona muerta para evitar valores residuales cerca del centro

// Declaración para una pantalla SSD1306 conectada a I2C (SDA, SCL pins)
Adafruit_SSD1306 display(SCREEN_WIDTH, SCREEN_HEIGHT, &Wire, OLED_RESET);

XboxSeriesXControllerESP32_asukiaaa::Core xboxController("3C:FA:06:0A:36:8F");

// Bitmap data for "KAIZEN" logo
const unsigned char epd_bitmap_KAIZEN [] PROGMEM = {
// '34', 128x64px
0x00, 0x00, 0x00, 0x00, 0x00, 0xff, 0xff, 0xf0, 0x00, 0x00, 0x00, 0x00, 0x00, 0x00, 0x00, 0x00, 
0x00, 0x00, 0x00, 0x00, 0x03, 0xff, 0xff, 0xfc, 0x00, 0x00, 0x00, 0x00, 0x00, 0x00, 0x00, 0x00, 
0x00, 0x00, 0x00, 0x00, 0x1f, 0xfc, 0x00, 0x03, 0x80, 0x00, 0x00, 0x00, 0x00, 0x00, 0x00, 0x00, 
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0x00, 0x00, 0x00, 0x00, 0x00, 0x00, 0x00, 0x00, 0x00, 0x00, 0x00, 0x00, 0x00, 0x00, 0x00, 0x00
};

void setupMotors() {
    pinMode(IN1_A, OUTPUT);
    pinMode(IN2_A, OUTPUT);
    pinMode(IN1_B, OUTPUT);
    pinMode(IN2_B, OUTPUT);

    // Configuración de canales PWM
    ledcSetup(0, 20000, 8); // Canal 0, frecuencia 20 kHz, resolución 8 bits para IN1_A
    ledcSetup(1, 20000, 8); // Canal 1, frecuencia 20 kHz, resolución 8 bits para IN2_A
    ledcSetup(2, 20000, 8); // Canal 2, frecuencia 20 kHz, resolución 8 bits para IN1_B
    ledcSetup(3, 20000, 8); // Canal 3, frecuencia 20 kHz, resolución 8 bits para IN2_B

    ledcAttachPin(IN1_A, 0); // Canal 0 al pin IN1_A
    ledcAttachPin(IN2_A, 1); // Canal 1 al pin IN2_A
    ledcAttachPin(IN1_B, 2); // Canal 2 al pin IN1_B
    ledcAttachPin(IN2_B, 3); // Canal 3 al pin IN2_B
}

void controlMotors(int leftMotorSpeed, int rightMotorSpeed) {
    // Control del motor izquierdo
    if (leftMotorSpeed > 0) {
        ledcWrite(0, leftMotorSpeed);
        ledcWrite(1, 0);
    } else if (leftMotorSpeed < 0) {
        ledcWrite(0, 0);
        ledcWrite(1, -leftMotorSpeed);
    } else {
        ledcWrite(0, 0);
        ledcWrite(1, 0);
    }

    // Control del motor derecho
    if (rightMotorSpeed > 0) {
        ledcWrite(2, rightMotorSpeed);
        ledcWrite(3, 0);
    } else if (rightMotorSpeed < 0) {
        ledcWrite(2, 0);
        ledcWrite(3, -rightMotorSpeed);
    } else {
        ledcWrite(2, 0);
        ledcWrite(3, 0);
    }
}

void setup() {
    Serial.begin(115200);
    setupMotors();
    xboxController.begin();

    // Inicializar pantalla OLED
    if (!display.begin(SSD1306_SWITCHCAPVCC, OLED_I2C_ADDRESS)) {
        Serial.println(F("SSD1306 allocation failed"));
        for (;;); // No seguir, bucle infinito
    }

    // Mostrar mensaje inicial
    display.clearDisplay();
    display.drawBitmap(0, 0, epd_bitmap_KAIZEN, 128, 64, SSD1306_WHITE);
    display.display(); // Enviar el contenido al display
}

void loop() {
    xboxController.onLoop();

    if (!xboxController.isConnected()) {
        Serial.println("Controller not connected.");
        delay(1000); // Esperar un breve período para evitar saturar la CPU
        return;
    }

    if (xboxController.isWaitingForFirstNotification()) {
        Serial.println("Waiting for first notification.");
        return;
    }

    uint16_t joystickMax = XboxControllerNotificationParser::maxJoy;

    float leftJoyY = (float)xboxController.xboxNotif.joyLVert / joystickMax;
    float rightJoyX = (float)xboxController.xboxNotif.joyRHori / joystickMax;

    // Aplicar zona muerta
    if (abs(leftJoyY - 0.5) < DEADZONE) leftJoyY = 0.5;
    if (abs(rightJoyX - 0.5) < DEADZONE) rightJoyX = 0.5;

    // Escalar las entradas de los joysticks
    int scaledSpeedForward = (leftJoyY - 0.5) * 5 * SPEED_SCALE;
    int scaledSpeedTurn = (rightJoyX - 0.5) * -5 * SPEED_SCALE;

    // Calcular las velocidades de los motores basadas en el control diferencial
    int leftMotorSpeed = scaledSpeedForward - scaledSpeedTurn;
    int rightMotorSpeed = scaledSpeedForward + scaledSpeedTurn;

    // Limitar los valores de velocidad a [-255, 255]
    leftMotorSpeed = constrain(leftMotorSpeed, -235, 235);
    rightMotorSpeed = constrain(rightMotorSpeed, -235, 235);

    controlMotors(leftMotorSpeed, rightMotorSpeed);

    delay(100); // Esperar un breve período para evitar saturar la CPU
}
